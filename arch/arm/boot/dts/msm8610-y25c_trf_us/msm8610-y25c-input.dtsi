/* Copyright (c) 2012, Code Aurora Forum. All rights reserved.
 *
 * This program is free software; you can redistribute it and/or modify
 * it under the terms of the GNU General Public License version 2 and
 * only version 2 as published by the Free Software Foundation.
 *
 * This program is distributed in the hope that it will be useful,
 * but WITHOUT ANY WARRANTY; without even the implied warranty of
 * MERCHANTABILITY or FITNESS FOR A PARTICULAR PURPOSE.  See the
 * GNU General Public License for more details.
 */

&soc {
	i2c@f9923000{
		lu201x@e {
			compatible = "leadingUI,lu201x";
			revision = "rev_a...rev_b";
			reg = <0xe>;
			status = "ok";

			interrupt-parent = <&msmgpio>;
			interrupts = <1 0x0>;
			vdd_io-supply = <&pm8110_l8>;
			vcc_i2c-supply = <0>;
			vcc_dig-supply = <0>;

			lu201x,reset-gpio = <&msmgpio 0 0x00>;
			lu201x,irq-gpio = <&msmgpio 1 0x00>;
			lu201x,sda-gpio = <&msmgpio 2 0x00>;
			lu201x,scl-gpio = <&msmgpio 3 0x00>;
			lu201x,ldo_en = <&msmgpio 62 0x00>;

			lu201x,key_map = <158 172 249>;
			lu201x,fw_name = "leadingUI/Y25_0215_0606.img";
			lu201x,global_access_pixel = <5>;
			lu201x,num_touch = <2>;
			lu201x,max_x = <320>;
			lu201x,max_y = <480>;
		};
		lu201x_revC@e {
			compatible = "leadingUI,lu201x";
			revision = "rev_c...";
			reg = <0xe>;
			status = "ok";

			interrupt-parent = <&msmgpio>;
			interrupts = <1 0x0>;
			vdd_io-supply = <&pm8110_l8>;
			vcc_i2c-supply = <0>;
			vcc_dig-supply = <0>;

			lu201x,reset-gpio = <&msmgpio 0 0x00>;
			lu201x,irq-gpio = <&msmgpio 1 0x00>;
			lu201x,sda-gpio = <&msmgpio 2 0x00>;
			lu201x,scl-gpio = <&msmgpio 3 0x00>;
			lu201x,ldo_en = <&msmgpio 62 0x00>;

			lu201x,key_map = <158 172 249>;
			lu201x,fw_name = "leadingUI/Y25_0304_0616.img";
			lu201x,global_access_pixel = <5>;
			lu201x,num_touch = <2>;
			lu201x,max_x = <320>;
			lu201x,max_y = <480>;
		};
	};
};
